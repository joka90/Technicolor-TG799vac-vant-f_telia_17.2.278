## bankmgr/src/bankmgr-1.0/Kconfig
```kconfig
config BANKMGR
	tristate "Bank manager kernel module"
	help
        this Kernel module provides access to the banktable through a /proc interface
```

## buttons/src/technicolor-button-1.0/Kconfig
```kconfig
config VDNTO_BUTTON
	tristate "VDNT-O Button Support"
	help
        Enable driver for VDNT-O Buttons
```

## gobinet/pkg/Config.in
```kconfig
menu "Gobinet configuration"
	depends on PACKAGE_kmod-gobinet

	choice
		prompt "Driver flavor"
		default GOBINET_SIERRA_WIRELESS

		config GOBINET_SIERRA_WIRELESS
			bool "Sierra"

		config GOBINET_QUECTEL
			bool "Quectel"

	endchoice

endmenu
```

## kernel/broadcom_kernel/kernel/linux-3.4rt/Kconfig
```kconfig
#
# For a description of the syntax of this configuration file,
# see Documentation/kbuild/kconfig-language.txt.
#
mainmenu "Linux/$ARCH $KERNELVERSION Kernel Configuration"

config SRCARCH
	string
	option env="SRCARCH"

source "arch/$SRCARCH/Kconfig"

#IGNORE_BCM_KF_EXCEPTION
source "Kconfig.bcm_kf"

source "Kconfig.bcm"

config BCM_IN_KERNEL
	bool
	default y


config TCH_KF_VOICE_DECT_MASK
	bool "Configure boardparms DECT bit-mask"
	default n

config TCH_KF_VOICE_DECT_MASK_ENBITS
	hex "boardparms voiceboardId enable bits in DECT bit-mask"
	depends on TCH_KF_VOICE_DECT_MASK

config TCH_KF_MINIMAL_RAM
	bool "minimize RAM usage"
	default n

config TCH_KF_PREALLOC_WL
	bool "preallocate memory for wl driver"
	default n

config TCH_KF_WLAN_PERF
	bool "WLAN perfomance improvements (for 4360 11AC)"
	default n

config TCH_NUM_STREAMS_8K
	bool "8K"
	default n

config TCH_NUM_STREAMS_16K
	bool "16K"
	default n

config TCH_NUM_STREAMS_32K
	bool "32K"
	default n

config BCM_DSL_GINP_RTX
	bool "Enable queues for G.INP"
	default n

config TCH_XTM_QUEUE_DEPTH_4700
	bool "4700"
	depends on BCM_DSL_GINP_RTX
	default n

config TCH_XTM_QUEUE_DEPTH_2350
	bool "2350"
	depends on BCM_DSL_GINP_RTX
	default n

config TCH_XTM_QUEUE_DEPTH_1175
	bool "1175"
	depends on BCM_DSL_GINP_RTX
	default n
```

## leds/src/technicolor-led-1.0/Kconfig
```kconfig
config TECHNICOLOR_LED
	tristate "Technicolor LED Support"
	help
        Enable LED driver for Technicolor Linux Gateways
```

## platform-gpl/src/platform-gpl-1.0/Kconfig
```kconfig
config TCHBLINFO
	tristate "Technicolor bootloader information"
	help
        this kernel module provides the bootloader version to userspace
```

## ripdrv/src/ripdrv-2014.01/Kconfig
```kconfig
config RIPDRV
     tristate "RIP kernel module"
     help
         this Kernel module provides access to the RIP on Technicolor Broadcom gateways
config RIPDRV_CRYPTO_SUPPORT
	depends RIPDRV
	bool "Support encrypted parameters in RIP"
	help
		select this option if your Technicolor gateway has a RIP with encrypted parameters.
```

## samba-tch/pkg/Config.in
```kconfig
config SAMBA-TCH_CONFIG_DEBUG 
	bool "Enable Logging for samba-tch"
	depends on PACKAGE_samba-tch
	default n
	help
		Enables debugging support (will make binaries *much* bigger)
		Also increases MAX_DEBUG_LEVEL to get more messages (also increases binary sizes!)

config SAMBA-TCH_CONFIG_PRINTING
	bool "Enable shared printing support"
	depends on PACKAGE_samba-tch
	select PACKAGE_cups
	default n
   	help
		Enable shared printing support.
		Adds about 18kB for smbd, about 15kB for nmbd and about 18kB for smbpasswd

config SAMBA-TCH_CONFIG_SMALLER
	bool "Make samba-tch even smaller"
	depends on PACKAGE_samba-tch
	default y
	help
		Removes support for ???
		Saves about 18kB for smbd, about 16kB for nmbd and about 17kB for smbpasswd
config SAMBA-TCH_REMOVE_VERSION
	bool "Hide the samba version."
	default n
	help
		This enables hiding of the samba version as security precaution
```
